
	ORG 0x6000

	DAT_PAT	da "ACIDHAUS" 	;# 8 Bytes / Name
			da 0x0000		;# 32 Bytes / Data
			da 0x0000
			da 0x0000
			da 0x0000
			da 0x0000
			da 0x0000
			da 0x0000
			da 0x0000
			da 0x0000
			da 0x0000
			da 0x0000
			da 0x0000
			da 0x0000
			da 0x0000
			da 0x0000
			da 0x0000
			da 0x0000		;# 2 Bytes / BPM
			da 0x0000		;# 2 Bytes / Steps
			da 0x0001		;# 2 Bytes / Protection
			da 0x0000		;# 18 Bytes unused
			da 0x0000
			da 0x0000
			da 0x0000
			da 0x0000
			da 0x0000
			da 0x0000
			da 0x0000
			da 0x0000
			
			da "[EMPTY!]" 	;# 8 Bytes / Name
			da 0x0000		;# 32 Bytes / Data
			da 0x0000
			da 0x0000
			da 0x0000
			da 0x0000
			da 0x0000
			da 0x0000
			da 0x0000
			da 0x0000
			da 0x0000
			da 0x0000
			da 0x0000
			da 0x0000
			da 0x0000
			da 0x0000
			da 0x0000
			da 0x0000		;# 2 Bytes / BPM
			da 0x0000		;# 2 Bytes / Steps
			da 0x0001		;# 2 Bytes / Protection
			da 0x0000		;# 18 Bytes unused
			da 0x0000
			da 0x0000
			da 0x0000
			da 0x0000
			da 0x0000
			da 0x0000
			da 0x0000
			da 0x0000
			
			da "[EMPTY!]" 	;# 8 Bytes / Name
			da 0x0000		;# 32 Bytes / Data
			da 0x0000
			da 0x0000
			da 0x0000
			da 0x0000
			da 0x0000
			da 0x0000
			da 0x0000
			da 0x0000
			da 0x0000
			da 0x0000
			da 0x0000
			da 0x0000
			da 0x0000
			da 0x0000
			da 0x0000
			da 0x0000		;# 2 Bytes / BPM
			da 0x0000		;# 2 Bytes / Steps
			da 0x0001		;# 2 Bytes / Protection
			da 0x0000		;# 18 Bytes unused
			da 0x0000
			da 0x0000
			da 0x0000
			da 0x0000
			da 0x0000
			da 0x0000
			da 0x0000
			da 0x0000
			
			da "[EMPTY!]" 	;# 8 Bytes / Name
			da 0x0000		;# 32 Bytes / Data
			da 0x0000
			da 0x0000
			da 0x0000
			da 0x0000
			da 0x0000
			da 0x0000
			da 0x0000
			da 0x0000
			da 0x0000
			da 0x0000
			da 0x0000
			da 0x0000
			da 0x0000
			da 0x0000
			da 0x0000
			da 0x0000		;# 2 Bytes / BPM
			da 0x0000		;# 2 Bytes / Steps
			da 0x0001		;# 2 Bytes / Protection
			da 0x0000		;# 18 Bytes unused
			da 0x0000
			da 0x0000
			da 0x0000
			da 0x0000
			da 0x0000
			da 0x0000
			da 0x0000
			da 0x0000
			
			da "[EMPTY!]" 	;# 8 Bytes / Name
			da 0x0000		;# 32 Bytes / Data
			da 0x0000
			da 0x0000
			da 0x0000
			da 0x0000
			da 0x0000
			da 0x0000
			da 0x0000
			da 0x0000
			da 0x0000
			da 0x0000
			da 0x0000
			da 0x0000
			da 0x0000
			da 0x0000
			da 0x0000
			da 0x0000		;# 2 Bytes / BPM
			da 0x0000		;# 2 Bytes / Steps
			da 0x0001		;# 2 Bytes / Protection
			da 0x0000		;# 18 Bytes unused
			da 0x0000
			da 0x0000
			da 0x0000
			da 0x0000
			da 0x0000
			da 0x0000
			da 0x0000
			da 0x0000
			
			da "[EMPTY!]" 	;# 8 Bytes / Name
			da 0x0000		;# 32 Bytes / Data
			da 0x0000
			da 0x0000
			da 0x0000
			da 0x0000
			da 0x0000
			da 0x0000
			da 0x0000
			da 0x0000
			da 0x0000
			da 0x0000
			da 0x0000
			da 0x0000
			da 0x0000
			da 0x0000
			da 0x0000
			da 0x0000		;# 2 Bytes / BPM
			da 0x0000		;# 2 Bytes / Steps
			da 0x0001		;# 2 Bytes / Protection
			da 0x0000		;# 18 Bytes unused
			da 0x0000
			da 0x0000
			da 0x0000
			da 0x0000
			da 0x0000
			da 0x0000
			da 0x0000
			da 0x0000
			
			da "[EMPTY!]" 	;# 8 Bytes / Name
			da 0x0000		;# 32 Bytes / Data
			da 0x0000
			da 0x0000
			da 0x0000
			da 0x0000
			da 0x0000
			da 0x0000
			da 0x0000
			da 0x0000
			da 0x0000
			da 0x0000
			da 0x0000
			da 0x0000
			da 0x0000
			da 0x0000
			da 0x0000
			da 0x0000		;# 2 Bytes / BPM
			da 0x0000		;# 2 Bytes / Steps
			da 0x0001		;# 2 Bytes / Protection
			da 0x0000		;# 18 Bytes unused
			da 0x0000
			da 0x0000
			da 0x0000
			da 0x0000
			da 0x0000
			da 0x0000
			da 0x0000
			da 0x0000
			
			da "[EMPTY!]" 	;# 8 Bytes / Name
			da 0x0000		;# 32 Bytes / Data
			da 0x0000
			da 0x0000
			da 0x0000
			da 0x0000
			da 0x0000
			da 0x0000
			da 0x0000
			da 0x0000
			da 0x0000
			da 0x0000
			da 0x0000
			da 0x0000
			da 0x0000
			da 0x0000
			da 0x0000
			da 0x0000		;# 2 Bytes / BPM
			da 0x0000		;# 2 Bytes / Steps
			da 0x0001		;# 2 Bytes / Protection
			da 0x0000		;# 18 Bytes unused
			da 0x0000
			da 0x0000
			da 0x0000
			da 0x0000
			da 0x0000
			da 0x0000
			da 0x0000
			da 0x0000
			
 			da "[EMPTY!]" 	;# 8 Bytes / Name
			da 0x0000		;# 32 Bytes / Data
			da 0x0000
			da 0x0000
			da 0x0000
			da 0x0000
			da 0x0000
			da 0x0000
			da 0x0000
			da 0x0000
			da 0x0000
			da 0x0000
			da 0x0000
			da 0x0000
			da 0x0000
			da 0x0000
			da 0x0000
			da 0x0000		;# 2 Bytes / BPM
			da 0x0000		;# 2 Bytes / Steps
			da 0x0001		;# 2 Bytes / Protection
			da 0x0000		;# 18 Bytes unused
			da 0x0000
			da 0x0000
			da 0x0000
			da 0x0000
			da 0x0000
			da 0x0000
			da 0x0000
			da 0x0000
			
			da "[EMPTY!]" 	;# 8 Bytes / Name
			da 0x0000		;# 32 Bytes / Data
			da 0x0000
			da 0x0000
			da 0x0000
			da 0x0000
			da 0x0000
			da 0x0000
			da 0x0000
			da 0x0000
			da 0x0000
			da 0x0000
			da 0x0000
			da 0x0000
			da 0x0000
			da 0x0000
			da 0x0000
			da 0x0000		;# 2 Bytes / BPM
			da 0x0000		;# 2 Bytes / Steps
			da 0x0001		;# 2 Bytes / Protection
			da 0x0000		;# 18 Bytes unused
			da 0x0000
			da 0x0000
			da 0x0000
			da 0x0000
			da 0x0000
			da 0x0000
			da 0x0000
			da 0x0000
			
			da "[EMPTY!]" 	;# 8 Bytes / Name
			da 0x0000		;# 32 Bytes / Data
			da 0x0000
			da 0x0000
			da 0x0000
			da 0x0000
			da 0x0000
			da 0x0000
			da 0x0000
			da 0x0000
			da 0x0000
			da 0x0000
			da 0x0000
			da 0x0000
			da 0x0000
			da 0x0000
			da 0x0000
			da 0x0000		;# 2 Bytes / BPM
			da 0x0000		;# 2 Bytes / Steps
			da 0x0001		;# 2 Bytes / Protection
			da 0x0000		;# 18 Bytes unused
			da 0x0000
			da 0x0000
			da 0x0000
			da 0x0000
			da 0x0000
			da 0x0000
			da 0x0000
			da 0x0000
			
			da "[EMPTY!]" 	;# 8 Bytes / Name
			da 0x0000		;# 32 Bytes / Data
			da 0x0000
			da 0x0000
			da 0x0000
			da 0x0000
			da 0x0000
			da 0x0000
			da 0x0000
			da 0x0000
			da 0x0000
			da 0x0000
			da 0x0000
			da 0x0000
			da 0x0000
			da 0x0000
			da 0x0000
			da 0x0000		;# 2 Bytes / BPM
			da 0x0000		;# 2 Bytes / Steps
			da 0x0001		;# 2 Bytes / Protection
			da 0x0000		;# 18 Bytes unused
			da 0x0000
			da 0x0000
			da 0x0000
			da 0x0000
			da 0x0000
			da 0x0000
			da 0x0000
			da 0x0000
			
			da "[EMPTY!]" 	;# 8 Bytes / Name
			da 0x0000		;# 32 Bytes / Data
			da 0x0000
			da 0x0000
			da 0x0000
			da 0x0000
			da 0x0000
			da 0x0000
			da 0x0000
			da 0x0000
			da 0x0000
			da 0x0000
			da 0x0000
			da 0x0000
			da 0x0000
			da 0x0000
			da 0x0000
			da 0x0000		;# 2 Bytes / BPM
			da 0x0000		;# 2 Bytes / Steps
			da 0x0001		;# 2 Bytes / Protection
			da 0x0000		;# 18 Bytes unused
			da 0x0000
			da 0x0000
			da 0x0000
			da 0x0000
			da 0x0000
			da 0x0000
			da 0x0000
			da 0x0000
			
			da "[EMPTY!]" 	;# 8 Bytes / Name
			da 0x0000		;# 32 Bytes / Data
			da 0x0000
			da 0x0000
			da 0x0000
			da 0x0000
			da 0x0000
			da 0x0000
			da 0x0000
			da 0x0000
			da 0x0000
			da 0x0000
			da 0x0000
			da 0x0000
			da 0x0000
			da 0x0000
			da 0x0000
			da 0x0000		;# 2 Bytes / BPM
			da 0x0000		;# 2 Bytes / Steps
			da 0x0001		;# 2 Bytes / Protection
			da 0x0000		;# 18 Bytes unused
			da 0x0000
			da 0x0000
			da 0x0000
			da 0x0000
			da 0x0000
			da 0x0000
			da 0x0000
			da 0x0000
			
			da "[EMPTY!]" 	;# 8 Bytes / Name
			da 0x0000		;# 32 Bytes / Data
			da 0x0000
			da 0x0000
			da 0x0000
			da 0x0000
			da 0x0000
			da 0x0000
			da 0x0000
			da 0x0000
			da 0x0000
			da 0x0000
			da 0x0000
			da 0x0000
			da 0x0000
			da 0x0000
			da 0x0000
			da 0x0000		;# 2 Bytes / BPM
			da 0x0000		;# 2 Bytes / Steps
			da 0x0001		;# 2 Bytes / Protection
			da 0x0000		;# 18 Bytes unused
			da 0x0000
			da 0x0000
			da 0x0000
			da 0x0000
			da 0x0000
			da 0x0000
			da 0x0000
			da 0x0000
			
			da "[EMPTY!]" 	;# 8 Bytes / Name
			da 0x0000		;# 32 Bytes / Data
			da 0x0000
			da 0x0000
			da 0x0000
			da 0x0000
			da 0x0000
			da 0x0000
			da 0x0000
			da 0x0000
			da 0x0000
			da 0x0000
			da 0x0000
			da 0x0000
			da 0x0000
			da 0x0000
			da 0x0000
			da 0x0000		;# 2 Bytes / BPM
			da 0x0000		;# 2 Bytes / Steps
			da 0x0001		;# 2 Bytes / Protection
			da 0x0000		;# 18 Bytes unused
			da 0x0000
			da 0x0000
			da 0x0000
			da 0x0000
			da 0x0000
			da 0x0000
			da 0x0000
			da 0x0000
			
 			da "[EMPTY!]" 	;# 8 Bytes / Name
			da 0x0000		;# 32 Bytes / Data
			da 0x0000
			da 0x0000
			da 0x0000
			da 0x0000
			da 0x0000
			da 0x0000
			da 0x0000
			da 0x0000
			da 0x0000
			da 0x0000
			da 0x0000
			da 0x0000
			da 0x0000
			da 0x0000
			da 0x0000
			da 0x0000		;# 2 Bytes / BPM
			da 0x0000		;# 2 Bytes / Steps
			da 0x0001		;# 2 Bytes / Protection
			da 0x0000		;# 18 Bytes unused
			da 0x0000
			da 0x0000
			da 0x0000
			da 0x0000
			da 0x0000
			da 0x0000
			da 0x0000
			da 0x0000
			
			da "[EMPTY!]" 	;# 8 Bytes / Name
			da 0x0000		;# 32 Bytes / Data
			da 0x0000
			da 0x0000
			da 0x0000
			da 0x0000
			da 0x0000
			da 0x0000
			da 0x0000
			da 0x0000
			da 0x0000
			da 0x0000
			da 0x0000
			da 0x0000
			da 0x0000
			da 0x0000
			da 0x0000
			da 0x0000		;# 2 Bytes / BPM
			da 0x0000		;# 2 Bytes / Steps
			da 0x0001		;# 2 Bytes / Protection
			da 0x0000		;# 18 Bytes unused
			da 0x0000
			da 0x0000
			da 0x0000
			da 0x0000
			da 0x0000
			da 0x0000
			da 0x0000
			da 0x0000
			
			da "[EMPTY!]" 	;# 8 Bytes / Name
			da 0x0000		;# 32 Bytes / Data
			da 0x0000
			da 0x0000
			da 0x0000
			da 0x0000
			da 0x0000
			da 0x0000
			da 0x0000
			da 0x0000
			da 0x0000
			da 0x0000
			da 0x0000
			da 0x0000
			da 0x0000
			da 0x0000
			da 0x0000
			da 0x0000		;# 2 Bytes / BPM
			da 0x0000		;# 2 Bytes / Steps
			da 0x0001		;# 2 Bytes / Protection
			da 0x0000		;# 18 Bytes unused
			da 0x0000
			da 0x0000
			da 0x0000
			da 0x0000
			da 0x0000
			da 0x0000
			da 0x0000
			da 0x0000
			
			da "[EMPTY!]" 	;# 8 Bytes / Name
			da 0x0000		;# 32 Bytes / Data
			da 0x0000
			da 0x0000
			da 0x0000
			da 0x0000
			da 0x0000
			da 0x0000
			da 0x0000
			da 0x0000
			da 0x0000
			da 0x0000
			da 0x0000
			da 0x0000
			da 0x0000
			da 0x0000
			da 0x0000
			da 0x0000		;# 2 Bytes / BPM
			da 0x0000		;# 2 Bytes / Steps
			da 0x0001		;# 2 Bytes / Protection
			da 0x0000		;# 18 Bytes unused
			da 0x0000
			da 0x0000
			da 0x0000
			da 0x0000
			da 0x0000
			da 0x0000
			da 0x0000
			da 0x0000
			
			da "[EMPTY!]" 	;# 8 Bytes / Name
			da 0x0000		;# 32 Bytes / Data
			da 0x0000
			da 0x0000
			da 0x0000
			da 0x0000
			da 0x0000
			da 0x0000
			da 0x0000
			da 0x0000
			da 0x0000
			da 0x0000
			da 0x0000
			da 0x0000
			da 0x0000
			da 0x0000
			da 0x0000
			da 0x0000		;# 2 Bytes / BPM
			da 0x0000		;# 2 Bytes / Steps
			da 0x0001		;# 2 Bytes / Protection
			da 0x0000		;# 18 Bytes unused
			da 0x0000
			da 0x0000
			da 0x0000
			da 0x0000
			da 0x0000
			da 0x0000
			da 0x0000
			da 0x0000
			
			da "[EMPTY!]" 	;# 8 Bytes / Name
			da 0x0000		;# 32 Bytes / Data
			da 0x0000
			da 0x0000
			da 0x0000
			da 0x0000
			da 0x0000
			da 0x0000
			da 0x0000
			da 0x0000
			da 0x0000
			da 0x0000
			da 0x0000
			da 0x0000
			da 0x0000
			da 0x0000
			da 0x0000
			da 0x0000		;# 2 Bytes / BPM
			da 0x0000		;# 2 Bytes / Steps
			da 0x0001		;# 2 Bytes / Protection
			da 0x0000		;# 18 Bytes unused
			da 0x0000
			da 0x0000
			da 0x0000
			da 0x0000
			da 0x0000
			da 0x0000
			da 0x0000
			da 0x0000
			
			da "[EMPTY!]" 	;# 8 Bytes / Name
			da 0x0000		;# 32 Bytes / Data
			da 0x0000
			da 0x0000
			da 0x0000
			da 0x0000
			da 0x0000
			da 0x0000
			da 0x0000
			da 0x0000
			da 0x0000
			da 0x0000
			da 0x0000
			da 0x0000
			da 0x0000
			da 0x0000
			da 0x0000
			da 0x0000		;# 2 Bytes / BPM
			da 0x0000		;# 2 Bytes / Steps
			da 0x0001		;# 2 Bytes / Protection
			da 0x0000		;# 18 Bytes unused
			da 0x0000
			da 0x0000
			da 0x0000
			da 0x0000
			da 0x0000
			da 0x0000
			da 0x0000
			da 0x0000
			
			da "[EMPTY!]" 	;# 8 Bytes / Name
			da 0x0000		;# 32 Bytes / Data
			da 0x0000
			da 0x0000
			da 0x0000
			da 0x0000
			da 0x0000
			da 0x0000
			da 0x0000
			da 0x0000
			da 0x0000
			da 0x0000
			da 0x0000
			da 0x0000
			da 0x0000
			da 0x0000
			da 0x0000
			da 0x0000		;# 2 Bytes / BPM
			da 0x0000		;# 2 Bytes / Steps
			da 0x0001		;# 2 Bytes / Protection
			da 0x0000		;# 18 Bytes unused
			da 0x0000
			da 0x0000
			da 0x0000
			da 0x0000
			da 0x0000
			da 0x0000
			da 0x0000
			da 0x0000
			
 			da "[EMPTY!]" 	;# 8 Bytes / Name
			da 0x0000		;# 32 Bytes / Data
			da 0x0000
			da 0x0000
			da 0x0000
			da 0x0000
			da 0x0000
			da 0x0000
			da 0x0000
			da 0x0000
			da 0x0000
			da 0x0000
			da 0x0000
			da 0x0000
			da 0x0000
			da 0x0000
			da 0x0000
			da 0x0000		;# 2 Bytes / BPM
			da 0x0000		;# 2 Bytes / Steps
			da 0x0001		;# 2 Bytes / Protection
			da 0x0000		;# 18 Bytes unused
			da 0x0000
			da 0x0000
			da 0x0000
			da 0x0000
			da 0x0000
			da 0x0000
			da 0x0000
			da 0x0000
			
			da "[EMPTY!]" 	;# 8 Bytes / Name
			da 0x0000		;# 32 Bytes / Data
			da 0x0000
			da 0x0000
			da 0x0000
			da 0x0000
			da 0x0000
			da 0x0000
			da 0x0000
			da 0x0000
			da 0x0000
			da 0x0000
			da 0x0000
			da 0x0000
			da 0x0000
			da 0x0000
			da 0x0000
			da 0x0000		;# 2 Bytes / BPM
			da 0x0000		;# 2 Bytes / Steps
			da 0x0001		;# 2 Bytes / Protection
			da 0x0000		;# 18 Bytes unused
			da 0x0000
			da 0x0000
			da 0x0000
			da 0x0000
			da 0x0000
			da 0x0000
			da 0x0000
			da 0x0000
			
			da "[EMPTY!]" 	;# 8 Bytes / Name
			da 0x0000		;# 32 Bytes / Data
			da 0x0000
			da 0x0000
			da 0x0000
			da 0x0000
			da 0x0000
			da 0x0000
			da 0x0000
			da 0x0000
			da 0x0000
			da 0x0000
			da 0x0000
			da 0x0000
			da 0x0000
			da 0x0000
			da 0x0000
			da 0x0000		;# 2 Bytes / BPM
			da 0x0000		;# 2 Bytes / Steps
			da 0x0001		;# 2 Bytes / Protection
			da 0x0000		;# 18 Bytes unused
			da 0x0000
			da 0x0000
			da 0x0000
			da 0x0000
			da 0x0000
			da 0x0000
			da 0x0000
			da 0x0000
			
			da "[EMPTY!]" 	;# 8 Bytes / Name
			da 0x0000		;# 32 Bytes / Data
			da 0x0000
			da 0x0000
			da 0x0000
			da 0x0000
			da 0x0000
			da 0x0000
			da 0x0000
			da 0x0000
			da 0x0000
			da 0x0000
			da 0x0000
			da 0x0000
			da 0x0000
			da 0x0000
			da 0x0000
			da 0x0000		;# 2 Bytes / BPM
			da 0x0000		;# 2 Bytes / Steps
			da 0x0001		;# 2 Bytes / Protection
			da 0x0000		;# 18 Bytes unused
			da 0x0000
			da 0x0000
			da 0x0000
			da 0x0000
			da 0x0000
			da 0x0000
			da 0x0000
			da 0x0000
			
			da "[EMPTY!]" 	;# 8 Bytes / Name
			da 0x0000		;# 32 Bytes / Data
			da 0x0000
			da 0x0000
			da 0x0000
			da 0x0000
			da 0x0000
			da 0x0000
			da 0x0000
			da 0x0000
			da 0x0000
			da 0x0000
			da 0x0000
			da 0x0000
			da 0x0000
			da 0x0000
			da 0x0000
			da 0x0000		;# 2 Bytes / BPM
			da 0x0000		;# 2 Bytes / Steps
			da 0x0001		;# 2 Bytes / Protection
			da 0x0000		;# 18 Bytes unused
			da 0x0000
			da 0x0000
			da 0x0000
			da 0x0000
			da 0x0000
			da 0x0000
			da 0x0000
			da 0x0000
			
			da "[EMPTY!]" 	;# 8 Bytes / Name
			da 0x0000		;# 32 Bytes / Data
			da 0x0000
			da 0x0000
			da 0x0000
			da 0x0000
			da 0x0000
			da 0x0000
			da 0x0000
			da 0x0000
			da 0x0000
			da 0x0000
			da 0x0000
			da 0x0000
			da 0x0000
			da 0x0000
			da 0x0000
			da 0x0000		;# 2 Bytes / BPM
			da 0x0000		;# 2 Bytes / Steps
			da 0x0001		;# 2 Bytes / Protection
			da 0x0000		;# 18 Bytes unused
			da 0x0000
			da 0x0000
			da 0x0000
			da 0x0000
			da 0x0000
			da 0x0000
			da 0x0000
			da 0x0000
			
			da "[EMPTY!]" 	;# 8 Bytes / Name
			da 0x0000		;# 32 Bytes / Data
			da 0x0000
			da 0x0000
			da 0x0000
			da 0x0000
			da 0x0000
			da 0x0000
			da 0x0000
			da 0x0000
			da 0x0000
			da 0x0000
			da 0x0000
			da 0x0000
			da 0x0000
			da 0x0000
			da 0x0000
			da 0x0000		;# 2 Bytes / BPM
			da 0x0000		;# 2 Bytes / Steps
			da 0x0001		;# 2 Bytes / Protection
			da 0x0000		;# 18 Bytes unused
			da 0x0000
			da 0x0000
			da 0x0000
			da 0x0000
			da 0x0000
			da 0x0000
			da 0x0000
			da 0x0000
			
			da "[EMPTY!]" 	;# 8 Bytes / Name
			da 0x0000		;# 32 Bytes / Data
			da 0x0000
			da 0x0000
			da 0x0000
			da 0x0000
			da 0x0000
			da 0x0000
			da 0x0000
			da 0x0000
			da 0x0000
			da 0x0000
			da 0x0000
			da 0x0000
			da 0x0000
			da 0x0000
			da 0x0000
			da 0x0000		;# 2 Bytes / BPM
			da 0x0000		;# 2 Bytes / Steps
			da 0x0001		;# 2 Bytes / Protection
			da 0x0000		;# 18 Bytes unused
			da 0x0000
			da 0x0000
			da 0x0000
			da 0x0000
			da 0x0000
			da 0x0000
			da 0x0000
			da 0x0000
			
 			da "[EMPTY!]" 	;# 8 Bytes / Name
			da 0x0000		;# 32 Bytes / Data
			da 0x0000
			da 0x0000
			da 0x0000
			da 0x0000
			da 0x0000
			da 0x0000
			da 0x0000
			da 0x0000
			da 0x0000
			da 0x0000
			da 0x0000
			da 0x0000
			da 0x0000
			da 0x0000
			da 0x0000
			da 0x0000		;# 2 Bytes / BPM
			da 0x0000		;# 2 Bytes / Steps
			da 0x0001		;# 2 Bytes / Protection
			da 0x0000		;# 18 Bytes unused
			da 0x0000
			da 0x0000
			da 0x0000
			da 0x0000
			da 0x0000
			da 0x0000
			da 0x0000
			da 0x0000
			
			da "[EMPTY!]" 	;# 8 Bytes / Name
			da 0x0000		;# 32 Bytes / Data
			da 0x0000
			da 0x0000
			da 0x0000
			da 0x0000
			da 0x0000
			da 0x0000
			da 0x0000
			da 0x0000
			da 0x0000
			da 0x0000
			da 0x0000
			da 0x0000
			da 0x0000
			da 0x0000
			da 0x0000
			da 0x0000		;# 2 Bytes / BPM
			da 0x0000		;# 2 Bytes / Steps
			da 0x0001		;# 2 Bytes / Protection
			da 0x0000		;# 18 Bytes unused
			da 0x0000
			da 0x0000
			da 0x0000
			da 0x0000
			da 0x0000
			da 0x0000
			da 0x0000
			da 0x0000
			
			da "[EMPTY!]" 	;# 8 Bytes / Name
			da 0x0000		;# 32 Bytes / Data
			da 0x0000
			da 0x0000
			da 0x0000
			da 0x0000
			da 0x0000
			da 0x0000
			da 0x0000
			da 0x0000
			da 0x0000
			da 0x0000
			da 0x0000
			da 0x0000
			da 0x0000
			da 0x0000
			da 0x0000
			da 0x0000		;# 2 Bytes / BPM
			da 0x0000		;# 2 Bytes / Steps
			da 0x0001		;# 2 Bytes / Protection
			da 0x0000		;# 18 Bytes unused
			da 0x0000
			da 0x0000
			da 0x0000
			da 0x0000
			da 0x0000
			da 0x0000
			da 0x0000
			da 0x0000
			
			da "[EMPTY!]" 	;# 8 Bytes / Name
			da 0x0000		;# 32 Bytes / Data
			da 0x0000
			da 0x0000
			da 0x0000
			da 0x0000
			da 0x0000
			da 0x0000
			da 0x0000
			da 0x0000
			da 0x0000
			da 0x0000
			da 0x0000
			da 0x0000
			da 0x0000
			da 0x0000
			da 0x0000
			da 0x0000		;# 2 Bytes / BPM
			da 0x0000		;# 2 Bytes / Steps
			da 0x0001		;# 2 Bytes / Protection
			da 0x0000		;# 18 Bytes unused
			da 0x0000
			da 0x0000
			da 0x0000
			da 0x0000
			da 0x0000
			da 0x0000
			da 0x0000
			da 0x0000
			
			da "[EMPTY!]" 	;# 8 Bytes / Name
			da 0x0000		;# 32 Bytes / Data
			da 0x0000
			da 0x0000
			da 0x0000
			da 0x0000
			da 0x0000
			da 0x0000
			da 0x0000
			da 0x0000
			da 0x0000
			da 0x0000
			da 0x0000
			da 0x0000
			da 0x0000
			da 0x0000
			da 0x0000
			da 0x0000		;# 2 Bytes / BPM
			da 0x0000		;# 2 Bytes / Steps
			da 0x0001		;# 2 Bytes / Protection
			da 0x0000		;# 18 Bytes unused
			da 0x0000
			da 0x0000
			da 0x0000
			da 0x0000
			da 0x0000
			da 0x0000
			da 0x0000
			da 0x0000
			
			da "[EMPTY!]" 	;# 8 Bytes / Name
			da 0x0000		;# 32 Bytes / Data
			da 0x0000
			da 0x0000
			da 0x0000
			da 0x0000
			da 0x0000
			da 0x0000
			da 0x0000
			da 0x0000
			da 0x0000
			da 0x0000
			da 0x0000
			da 0x0000
			da 0x0000
			da 0x0000
			da 0x0000
			da 0x0000		;# 2 Bytes / BPM
			da 0x0000		;# 2 Bytes / Steps
			da 0x0001		;# 2 Bytes / Protection
			da 0x0000		;# 18 Bytes unused
			da 0x0000
			da 0x0000
			da 0x0000
			da 0x0000
			da 0x0000
			da 0x0000
			da 0x0000
			da 0x0000
			
			da "[EMPTY!]" 	;# 8 Bytes / Name
			da 0x0000		;# 32 Bytes / Data
			da 0x0000
			da 0x0000
			da 0x0000
			da 0x0000
			da 0x0000
			da 0x0000
			da 0x0000
			da 0x0000
			da 0x0000
			da 0x0000
			da 0x0000
			da 0x0000
			da 0x0000
			da 0x0000
			da 0x0000
			da 0x0000		;# 2 Bytes / BPM
			da 0x0000		;# 2 Bytes / Steps
			da 0x0001		;# 2 Bytes / Protection
			da 0x0000		;# 18 Bytes unused
			da 0x0000
			da 0x0000
			da 0x0000
			da 0x0000
			da 0x0000
			da 0x0000
			da 0x0000
			da 0x0000
			
			da "[EMPTY!]" 	;# 8 Bytes / Name
			da 0x0000		;# 32 Bytes / Data
			da 0x0000
			da 0x0000
			da 0x0000
			da 0x0000
			da 0x0000
			da 0x0000
			da 0x0000
			da 0x0000
			da 0x0000
			da 0x0000
			da 0x0000
			da 0x0000
			da 0x0000
			da 0x0000
			da 0x0000
			da 0x0000		;# 2 Bytes / BPM
			da 0x0000		;# 2 Bytes / Steps
			da 0x0001		;# 2 Bytes / Protection
			da 0x0000		;# 18 Bytes unused
			da 0x0000
			da 0x0000
			da 0x0000
			da 0x0000
			da 0x0000
			da 0x0000
			da 0x0000
			da 0x0000
			
 			da "[EMPTY!]" 	;# 8 Bytes / Name
			da 0x0000		;# 32 Bytes / Data
			da 0x0000
			da 0x0000
			da 0x0000
			da 0x0000
			da 0x0000
			da 0x0000
			da 0x0000
			da 0x0000
			da 0x0000
			da 0x0000
			da 0x0000
			da 0x0000
			da 0x0000
			da 0x0000
			da 0x0000
			da 0x0000		;# 2 Bytes / BPM
			da 0x0000		;# 2 Bytes / Steps
			da 0x0001		;# 2 Bytes / Protection
			da 0x0000		;# 18 Bytes unused
			da 0x0000
			da 0x0000
			da 0x0000
			da 0x0000
			da 0x0000
			da 0x0000
			da 0x0000
			da 0x0000
			
			da "[EMPTY!]" 	;# 8 Bytes / Name
			da 0x0000		;# 32 Bytes / Data
			da 0x0000
			da 0x0000
			da 0x0000
			da 0x0000
			da 0x0000
			da 0x0000
			da 0x0000
			da 0x0000
			da 0x0000
			da 0x0000
			da 0x0000
			da 0x0000
			da 0x0000
			da 0x0000
			da 0x0000
			da 0x0000		;# 2 Bytes / BPM
			da 0x0000		;# 2 Bytes / Steps
			da 0x0001		;# 2 Bytes / Protection
			da 0x0000		;# 18 Bytes unused
			da 0x0000
			da 0x0000
			da 0x0000
			da 0x0000
			da 0x0000
			da 0x0000
			da 0x0000
			da 0x0000
			
			da "[EMPTY!]" 	;# 8 Bytes / Name
			da 0x0000		;# 32 Bytes / Data
			da 0x0000
			da 0x0000
			da 0x0000
			da 0x0000
			da 0x0000
			da 0x0000
			da 0x0000
			da 0x0000
			da 0x0000
			da 0x0000
			da 0x0000
			da 0x0000
			da 0x0000
			da 0x0000
			da 0x0000
			da 0x0000		;# 2 Bytes / BPM
			da 0x0000		;# 2 Bytes / Steps
			da 0x0001		;# 2 Bytes / Protection
			da 0x0000		;# 18 Bytes unused
			da 0x0000
			da 0x0000
			da 0x0000
			da 0x0000
			da 0x0000
			da 0x0000
			da 0x0000
			da 0x0000
			
			da "[EMPTY!]" 	;# 8 Bytes / Name
			da 0x0000		;# 32 Bytes / Data
			da 0x0000
			da 0x0000
			da 0x0000
			da 0x0000
			da 0x0000
			da 0x0000
			da 0x0000
			da 0x0000
			da 0x0000
			da 0x0000
			da 0x0000
			da 0x0000
			da 0x0000
			da 0x0000
			da 0x0000
			da 0x0000		;# 2 Bytes / BPM
			da 0x0000		;# 2 Bytes / Steps
			da 0x0001		;# 2 Bytes / Protection
			da 0x0000		;# 18 Bytes unused
			da 0x0000
			da 0x0000
			da 0x0000
			da 0x0000
			da 0x0000
			da 0x0000
			da 0x0000
			da 0x0000
			
			da "[EMPTY!]" 	;# 8 Bytes / Name
			da 0x0000		;# 32 Bytes / Data
			da 0x0000
			da 0x0000
			da 0x0000
			da 0x0000
			da 0x0000
			da 0x0000
			da 0x0000
			da 0x0000
			da 0x0000
			da 0x0000
			da 0x0000
			da 0x0000
			da 0x0000
			da 0x0000
			da 0x0000
			da 0x0000		;# 2 Bytes / BPM
			da 0x0000		;# 2 Bytes / Steps
			da 0x0001		;# 2 Bytes / Protection
			da 0x0000		;# 18 Bytes unused
			da 0x0000
			da 0x0000
			da 0x0000
			da 0x0000
			da 0x0000
			da 0x0000
			da 0x0000
			da 0x0000
			
			da "[EMPTY!]" 	;# 8 Bytes / Name
			da 0x0000		;# 32 Bytes / Data
			da 0x0000
			da 0x0000
			da 0x0000
			da 0x0000
			da 0x0000
			da 0x0000
			da 0x0000
			da 0x0000
			da 0x0000
			da 0x0000
			da 0x0000
			da 0x0000
			da 0x0000
			da 0x0000
			da 0x0000
			da 0x0000		;# 2 Bytes / BPM
			da 0x0000		;# 2 Bytes / Steps
			da 0x0001		;# 2 Bytes / Protection
			da 0x0000		;# 18 Bytes unused
			da 0x0000
			da 0x0000
			da 0x0000
			da 0x0000
			da 0x0000
			da 0x0000
			da 0x0000
			da 0x0000
			
			da "[EMPTY!]" 	;# 8 Bytes / Name
			da 0x0000		;# 32 Bytes / Data
			da 0x0000
			da 0x0000
			da 0x0000
			da 0x0000
			da 0x0000
			da 0x0000
			da 0x0000
			da 0x0000
			da 0x0000
			da 0x0000
			da 0x0000
			da 0x0000
			da 0x0000
			da 0x0000
			da 0x0000
			da 0x0000		;# 2 Bytes / BPM
			da 0x0000		;# 2 Bytes / Steps
			da 0x0001		;# 2 Bytes / Protection
			da 0x0000		;# 18 Bytes unused
			da 0x0000
			da 0x0000
			da 0x0000
			da 0x0000
			da 0x0000
			da 0x0000
			da 0x0000
			da 0x0000
			
			da "[EMPTY!]" 	;# 8 Bytes / Name
			da 0x0000		;# 32 Bytes / Data
			da 0x0000
			da 0x0000
			da 0x0000
			da 0x0000
			da 0x0000
			da 0x0000
			da 0x0000
			da 0x0000
			da 0x0000
			da 0x0000
			da 0x0000
			da 0x0000
			da 0x0000
			da 0x0000
			da 0x0000
			da 0x0000		;# 2 Bytes / BPM
			da 0x0000		;# 2 Bytes / Steps
			da 0x0001		;# 2 Bytes / Protection
			da 0x0000		;# 18 Bytes unused
			da 0x0000
			da 0x0000
			da 0x0000
			da 0x0000
			da 0x0000
			da 0x0000
			da 0x0000
			da 0x0000
			
 			da "[EMPTY!]" 	;# 8 Bytes / Name
			da 0x0000		;# 32 Bytes / Data
			da 0x0000
			da 0x0000
			da 0x0000
			da 0x0000
			da 0x0000
			da 0x0000
			da 0x0000
			da 0x0000
			da 0x0000
			da 0x0000
			da 0x0000
			da 0x0000
			da 0x0000
			da 0x0000
			da 0x0000
			da 0x0000		;# 2 Bytes / BPM
			da 0x0000		;# 2 Bytes / Steps
			da 0x0001		;# 2 Bytes / Protection
			da 0x0000		;# 18 Bytes unused
			da 0x0000
			da 0x0000
			da 0x0000
			da 0x0000
			da 0x0000
			da 0x0000
			da 0x0000
			da 0x0000
			
			da "[EMPTY!]" 	;# 8 Bytes / Name
			da 0x0000		;# 32 Bytes / Data
			da 0x0000
			da 0x0000
			da 0x0000
			da 0x0000
			da 0x0000
			da 0x0000
			da 0x0000
			da 0x0000
			da 0x0000
			da 0x0000
			da 0x0000
			da 0x0000
			da 0x0000
			da 0x0000
			da 0x0000
			da 0x0000		;# 2 Bytes / BPM
			da 0x0000		;# 2 Bytes / Steps
			da 0x0001		;# 2 Bytes / Protection
			da 0x0000		;# 18 Bytes unused
			da 0x0000
			da 0x0000
			da 0x0000
			da 0x0000
			da 0x0000
			da 0x0000
			da 0x0000
			da 0x0000
			
			da "[EMPTY!]" 	;# 8 Bytes / Name
			da 0x0000		;# 32 Bytes / Data
			da 0x0000
			da 0x0000
			da 0x0000
			da 0x0000
			da 0x0000
			da 0x0000
			da 0x0000
			da 0x0000
			da 0x0000
			da 0x0000
			da 0x0000
			da 0x0000
			da 0x0000
			da 0x0000
			da 0x0000
			da 0x0000		;# 2 Bytes / BPM
			da 0x0000		;# 2 Bytes / Steps
			da 0x0001		;# 2 Bytes / Protection
			da 0x0000		;# 18 Bytes unused
			da 0x0000
			da 0x0000
			da 0x0000
			da 0x0000
			da 0x0000
			da 0x0000
			da 0x0000
			da 0x0000
			
			da "[EMPTY!]" 	;# 8 Bytes / Name
			da 0x0000		;# 32 Bytes / Data
			da 0x0000
			da 0x0000
			da 0x0000
			da 0x0000
			da 0x0000
			da 0x0000
			da 0x0000
			da 0x0000
			da 0x0000
			da 0x0000
			da 0x0000
			da 0x0000
			da 0x0000
			da 0x0000
			da 0x0000
			da 0x0000		;# 2 Bytes / BPM
			da 0x0000		;# 2 Bytes / Steps
			da 0x0001		;# 2 Bytes / Protection
			da 0x0000		;# 18 Bytes unused
			da 0x0000
			da 0x0000
			da 0x0000
			da 0x0000
			da 0x0000
			da 0x0000
			da 0x0000
			da 0x0000
			
			da "[EMPTY!]" 	;# 8 Bytes / Name
			da 0x0000		;# 32 Bytes / Data
			da 0x0000
			da 0x0000
			da 0x0000
			da 0x0000
			da 0x0000
			da 0x0000
			da 0x0000
			da 0x0000
			da 0x0000
			da 0x0000
			da 0x0000
			da 0x0000
			da 0x0000
			da 0x0000
			da 0x0000
			da 0x0000		;# 2 Bytes / BPM
			da 0x0000		;# 2 Bytes / Steps
			da 0x0001		;# 2 Bytes / Protection
			da 0x0000		;# 18 Bytes unused
			da 0x0000
			da 0x0000
			da 0x0000
			da 0x0000
			da 0x0000
			da 0x0000
			da 0x0000
			da 0x0000
			
			da "[EMPTY!]" 	;# 8 Bytes / Name
			da 0x0000		;# 32 Bytes / Data
			da 0x0000
			da 0x0000
			da 0x0000
			da 0x0000
			da 0x0000
			da 0x0000
			da 0x0000
			da 0x0000
			da 0x0000
			da 0x0000
			da 0x0000
			da 0x0000
			da 0x0000
			da 0x0000
			da 0x0000
			da 0x0000		;# 2 Bytes / BPM
			da 0x0000		;# 2 Bytes / Steps
			da 0x0001		;# 2 Bytes / Protection
			da 0x0000		;# 18 Bytes unused
			da 0x0000
			da 0x0000
			da 0x0000
			da 0x0000
			da 0x0000
			da 0x0000
			da 0x0000
			da 0x0000
			
			da "[EMPTY!]" 	;# 8 Bytes / Name
			da 0x0000		;# 32 Bytes / Data
			da 0x0000
			da 0x0000
			da 0x0000
			da 0x0000
			da 0x0000
			da 0x0000
			da 0x0000
			da 0x0000
			da 0x0000
			da 0x0000
			da 0x0000
			da 0x0000
			da 0x0000
			da 0x0000
			da 0x0000
			da 0x0000		;# 2 Bytes / BPM
			da 0x0000		;# 2 Bytes / Steps
			da 0x0001		;# 2 Bytes / Protection
			da 0x0000		;# 18 Bytes unused
			da 0x0000
			da 0x0000
			da 0x0000
			da 0x0000
			da 0x0000
			da 0x0000
			da 0x0000
			da 0x0000
			
			da "[EMPTY!]" 	;# 8 Bytes / Name
			da 0x0000		;# 32 Bytes / Data
			da 0x0000
			da 0x0000
			da 0x0000
			da 0x0000
			da 0x0000
			da 0x0000
			da 0x0000
			da 0x0000
			da 0x0000
			da 0x0000
			da 0x0000
			da 0x0000
			da 0x0000
			da 0x0000
			da 0x0000
			da 0x0000		;# 2 Bytes / BPM
			da 0x0000		;# 2 Bytes / Steps
			da 0x0001		;# 2 Bytes / Protection
			da 0x0000		;# 18 Bytes unused
			da 0x0000
			da 0x0000
			da 0x0000
			da 0x0000
			da 0x0000
			da 0x0000
			da 0x0000
			da 0x0000
			
 			da "[EMPTY!]" 	;# 8 Bytes / Name
			da 0x0000		;# 32 Bytes / Data
			da 0x0000
			da 0x0000
			da 0x0000
			da 0x0000
			da 0x0000
			da 0x0000
			da 0x0000
			da 0x0000
			da 0x0000
			da 0x0000
			da 0x0000
			da 0x0000
			da 0x0000
			da 0x0000
			da 0x0000
			da 0x0000		;# 2 Bytes / BPM
			da 0x0000		;# 2 Bytes / Steps
			da 0x0001		;# 2 Bytes / Protection
			da 0x0000		;# 18 Bytes unused
			da 0x0000
			da 0x0000
			da 0x0000
			da 0x0000
			da 0x0000
			da 0x0000
			da 0x0000
			da 0x0000
			
			da "[EMPTY!]" 	;# 8 Bytes / Name
			da 0x0000		;# 32 Bytes / Data
			da 0x0000
			da 0x0000
			da 0x0000
			da 0x0000
			da 0x0000
			da 0x0000
			da 0x0000
			da 0x0000
			da 0x0000
			da 0x0000
			da 0x0000
			da 0x0000
			da 0x0000
			da 0x0000
			da 0x0000
			da 0x0000		;# 2 Bytes / BPM
			da 0x0000		;# 2 Bytes / Steps
			da 0x0001		;# 2 Bytes / Protection
			da 0x0000		;# 18 Bytes unused
			da 0x0000
			da 0x0000
			da 0x0000
			da 0x0000
			da 0x0000
			da 0x0000
			da 0x0000
			da 0x0000
			
			da "[EMPTY!]" 	;# 8 Bytes / Name
			da 0x0000		;# 32 Bytes / Data
			da 0x0000
			da 0x0000
			da 0x0000
			da 0x0000
			da 0x0000
			da 0x0000
			da 0x0000
			da 0x0000
			da 0x0000
			da 0x0000
			da 0x0000
			da 0x0000
			da 0x0000
			da 0x0000
			da 0x0000
			da 0x0000		;# 2 Bytes / BPM
			da 0x0000		;# 2 Bytes / Steps
			da 0x0001		;# 2 Bytes / Protection
			da 0x0000		;# 18 Bytes unused
			da 0x0000
			da 0x0000
			da 0x0000
			da 0x0000
			da 0x0000
			da 0x0000
			da 0x0000
			da 0x0000
			
			da "[EMPTY!]" 	;# 8 Bytes / Name
			da 0x0000		;# 32 Bytes / Data
			da 0x0000
			da 0x0000
			da 0x0000
			da 0x0000
			da 0x0000
			da 0x0000
			da 0x0000
			da 0x0000
			da 0x0000
			da 0x0000
			da 0x0000
			da 0x0000
			da 0x0000
			da 0x0000
			da 0x0000
			da 0x0000		;# 2 Bytes / BPM
			da 0x0000		;# 2 Bytes / Steps
			da 0x0001		;# 2 Bytes / Protection
			da 0x0000		;# 18 Bytes unused
			da 0x0000
			da 0x0000
			da 0x0000
			da 0x0000
			da 0x0000
			da 0x0000
			da 0x0000
			da 0x0000
			
			da "[EMPTY!]" 	;# 8 Bytes / Name
			da 0x0000		;# 32 Bytes / Data
			da 0x0000
			da 0x0000
			da 0x0000
			da 0x0000
			da 0x0000
			da 0x0000
			da 0x0000
			da 0x0000
			da 0x0000
			da 0x0000
			da 0x0000
			da 0x0000
			da 0x0000
			da 0x0000
			da 0x0000
			da 0x0000		;# 2 Bytes / BPM
			da 0x0000		;# 2 Bytes / Steps
			da 0x0001		;# 2 Bytes / Protection
			da 0x0000		;# 18 Bytes unused
			da 0x0000
			da 0x0000
			da 0x0000
			da 0x0000
			da 0x0000
			da 0x0000
			da 0x0000
			da 0x0000
			
			da "[EMPTY!]" 	;# 8 Bytes / Name
			da 0x0000		;# 32 Bytes / Data
			da 0x0000
			da 0x0000
			da 0x0000
			da 0x0000
			da 0x0000
			da 0x0000
			da 0x0000
			da 0x0000
			da 0x0000
			da 0x0000
			da 0x0000
			da 0x0000
			da 0x0000
			da 0x0000
			da 0x0000
			da 0x0000		;# 2 Bytes / BPM
			da 0x0000		;# 2 Bytes / Steps
			da 0x0001		;# 2 Bytes / Protection
			da 0x0000		;# 18 Bytes unused
			da 0x0000
			da 0x0000
			da 0x0000
			da 0x0000
			da 0x0000
			da 0x0000
			da 0x0000
			da 0x0000
			
			da "[EMPTY!]" 	;# 8 Bytes / Name
			da 0x0000		;# 32 Bytes / Data
			da 0x0000
			da 0x0000
			da 0x0000
			da 0x0000
			da 0x0000
			da 0x0000
			da 0x0000
			da 0x0000
			da 0x0000
			da 0x0000
			da 0x0000
			da 0x0000
			da 0x0000
			da 0x0000
			da 0x0000
			da 0x0000		;# 2 Bytes / BPM
			da 0x0000		;# 2 Bytes / Steps
			da 0x0001		;# 2 Bytes / Protection
			da 0x0000		;# 18 Bytes unused
			da 0x0000
			da 0x0000
			da 0x0000
			da 0x0000
			da 0x0000
			da 0x0000
			da 0x0000
			da 0x0000
			
			da "[EMPTY!]" 	;# 8 Bytes / Name
			da 0x0000		;# 32 Bytes / Data
			da 0x0000
			da 0x0000
			da 0x0000
			da 0x0000
			da 0x0000
			da 0x0000
			da 0x0000
			da 0x0000
			da 0x0000
			da 0x0000
			da 0x0000
			da 0x0000
			da 0x0000
			da 0x0000
			da 0x0000
			da 0x0000		;# 2 Bytes / BPM
			da 0x0000		;# 2 Bytes / Steps
			da 0x0001		;# 2 Bytes / Protection
			da 0x0000		;# 18 Bytes unused
			da 0x0000
			da 0x0000
			da 0x0000
			da 0x0000
			da 0x0000
			da 0x0000
			da 0x0000
			da 0x0000
			
	DAT_SNG	da "[EMPTY!]" 	;# 8 Bytes / Name
			da 0x0000		;# 2 Bytes / Loop
			da 0x0000		;# 50 Bytes / Data
			da 0x0000
			da 0x0000
			da 0x0000
			da 0x0000
			da 0x0000
			da 0x0000
			da 0x0000
			da 0x0000
			da 0x0000
			da 0x0000
			da 0x0000
			da 0x0000
			da 0x0000
			da 0x0000
			da 0x0000
			da 0x0000
			da 0x0000
			da 0x0000
			da 0x0000
			da 0x0000
			da 0x0000
			da 0x0000
			da 0x0000
			da 0x0000
			da 0x0000		;# BPM
			da 0x0000		;# Steps

			da "[EMPTY!]" 	;# 8 Bytes / Name
			da 0x0000		;# 2 Bytes / Loop
			da 0x0000		;# 50 Bytes / Data
			da 0x0000
			da 0x0000
			da 0x0000
			da 0x0000
			da 0x0000
			da 0x0000
			da 0x0000
			da 0x0000
			da 0x0000
			da 0x0000
			da 0x0000
			da 0x0000
			da 0x0000
			da 0x0000
			da 0x0000
			da 0x0000
			da 0x0000
			da 0x0000
			da 0x0000
			da 0x0000
			da 0x0000
			da 0x0000
			da 0x0000
			da 0x0000
			da 0x0000		;# BPM
			da 0x0000		;# Steps

			da "[EMPTY!]" 	;# 8 Bytes / Name
			da 0x0000		;# 2 Bytes / Loop
			da 0x0000		;# 50 Bytes / Data
			da 0x0000
			da 0x0000
			da 0x0000
			da 0x0000
			da 0x0000
			da 0x0000
			da 0x0000
			da 0x0000
			da 0x0000
			da 0x0000
			da 0x0000
			da 0x0000
			da 0x0000
			da 0x0000
			da 0x0000
			da 0x0000
			da 0x0000
			da 0x0000
			da 0x0000
			da 0x0000
			da 0x0000
			da 0x0000
			da 0x0000
			da 0x0000
			da 0x0000		;# BPM
			da 0x0000		;# Steps

			da "[EMPTY!]" 	;# 8 Bytes / Name
			da 0x0000		;# 2 Bytes / Loop
			da 0x0000		;# 50 Bytes / Data
			da 0x0000
			da 0x0000
			da 0x0000
			da 0x0000
			da 0x0000
			da 0x0000
			da 0x0000
			da 0x0000
			da 0x0000
			da 0x0000
			da 0x0000
			da 0x0000
			da 0x0000
			da 0x0000
			da 0x0000
			da 0x0000
			da 0x0000
			da 0x0000
			da 0x0000
			da 0x0000
			da 0x0000
			da 0x0000
			da 0x0000
			da 0x0000
			da 0x0000		;# BPM
			da 0x0000		;# Steps

			da "[EMPTY!]" 	;# 8 Bytes / Name
			da 0x0000		;# 2 Bytes / Loop
			da 0x0000		;# 50 Bytes / Data
			da 0x0000
			da 0x0000
			da 0x0000
			da 0x0000
			da 0x0000
			da 0x0000
			da 0x0000
			da 0x0000
			da 0x0000
			da 0x0000
			da 0x0000
			da 0x0000
			da 0x0000
			da 0x0000
			da 0x0000
			da 0x0000
			da 0x0000
			da 0x0000
			da 0x0000
			da 0x0000
			da 0x0000
			da 0x0000
			da 0x0000
			da 0x0000
			da 0x0000		;# BPM
			da 0x0000		;# Steps

			da "[EMPTY!]" 	;# 8 Bytes / Name
			da 0x0000		;# 2 Bytes / Loop
			da 0x0000		;# 50 Bytes / Data
			da 0x0000
			da 0x0000
			da 0x0000
			da 0x0000
			da 0x0000
			da 0x0000
			da 0x0000
			da 0x0000
			da 0x0000
			da 0x0000
			da 0x0000
			da 0x0000
			da 0x0000
			da 0x0000
			da 0x0000
			da 0x0000
			da 0x0000
			da 0x0000
			da 0x0000
			da 0x0000
			da 0x0000
			da 0x0000
			da 0x0000
			da 0x0000
			da 0x0000		;# BPM
			da 0x0000		;# Steps

			da "[EMPTY!]" 	;# 8 Bytes / Name
			da 0x0000		;# 2 Bytes / Loop
			da 0x0000		;# 50 Bytes / Data
			da 0x0000
			da 0x0000
			da 0x0000
			da 0x0000
			da 0x0000
			da 0x0000
			da 0x0000
			da 0x0000
			da 0x0000
			da 0x0000
			da 0x0000
			da 0x0000
			da 0x0000
			da 0x0000
			da 0x0000
			da 0x0000
			da 0x0000
			da 0x0000
			da 0x0000
			da 0x0000
			da 0x0000
			da 0x0000
			da 0x0000
			da 0x0000
			da 0x0000		;# BPM
			da 0x0000		;# Steps

			da "[EMPTY!]" 	;# 8 Bytes / Name
			da 0x0000		;# 2 Bytes / Loop
			da 0x0000		;# 50 Bytes / Data
			da 0x0000
			da 0x0000
			da 0x0000
			da 0x0000
			da 0x0000
			da 0x0000
			da 0x0000
			da 0x0000
			da 0x0000
			da 0x0000
			da 0x0000
			da 0x0000
			da 0x0000
			da 0x0000
			da 0x0000
			da 0x0000
			da 0x0000
			da 0x0000
			da 0x0000
			da 0x0000
			da 0x0000
			da 0x0000
			da 0x0000
			da 0x0000
			da 0x0000		;# BPM
			da 0x0000		;# Steps
			
TXT_INTRO_0 da 0x1000,		"*** Acidcode ***"
TXT_INTRO_1 da 0x1040,		"*** BassLine ***"

TXT_COPYRIGHT_0 da 0x1000, 	"(C)opyright 2004"
TXT_COPYRIGHT_1 da 0x1040, 	" Mathias Maerker"

TXT_ERROR_0 da 0x1000,		"?ERROR:         "
TXT_ERROR_01_1 da 0x1040,	"01: MEM FAILURE "
TXT_ERROR_02_1 da 0x1040,	"02: BUF OVERFLOW"
TXT_ERROR_03_1 da 0x1040,	"03: INVALID DATA"
TXT_ERROR_04_1 da 0x1040,	"04: BATTERY LOW "
TXT_ERROR_05_1 da 0x1040,	"05: AREA LOCKED "
TXT_ERROR_06_1 da 0x1040,	"06: "
TXT_ERROR_99_1 da 0x1040,	"99: UNKNOWN ERR."

TXT_PAT_0 da 0x1000,		"PAT 01:         "
TXT_PAT_1 da 0x1040, 		"  |  |  |  |  | "
TXT_FNC_1 da 0x1040, 		"CUR 01   NEXT 01"
;TXT_PAT_1 da 0x1040, 		"01|C#|DN|AC|SL|-"

TXT_SNG_0 da 0x1000,		"SNG 01:         "
TXT_SNG_1 da 0x1040, 		"POS 01 -> PAT 01"

TXT_BPE_1 da 0x1040, 		"BPM (EXT): 000.0"
TXT_BPI_1 da 0x1040, 		"BPM (INT): 000.0"
TXT_LEN_1 da 0x1040, 		"LENGTH: 16/16   "
TXT_CLR_1 da 0x1040, 		"Clear (Y/N) ?   "
TXT_RDY_1 da 0x1040, 		"**** Ready! ****"
TXT_STP_1 da 0x1040, 		":...:...:...:..."
TXT_SAV_1 da 0x1040, 		"Saving...       "
TXT_LOD_1 da 0x1040, 		"Loading...      "

TXT_HLP_NAME_1 da 0x1040,	"Enter Pat Name  "
TXT_HLP_NAME_2 da 0x1040,	"Use WHITE Keys  "
TXT_HLP_NAME_3 da 0x1040,	"for Position 1-8"
TXT_HLP_NAME_4 da 0x1040,	"and choose Chars"
TXT_HLP_NAME_5 da 0x1040,	"with TAP & BACK."
TXT_HLP_NAME_6 da 0x1040,	"Use FUNC to exit"

