BPM_TABLE_A
	db	-1-	80		,	-1-	254
	db	-1-	80		,	-1-	254
	db	-1-	80		,	-1-	254
	db	-1-	80		,	-1-	254
	db	-1-	80		,	-1-	254
	db	-1-	80		,	-1-	254
	db	-1-	80		,	-1-	254
	db	-1-	80		,	-1-	254
	db	-1-	80		,	-1-	254
	db	-1-	80		,	-1-	254
	db	-1-	80		,	-1-	254
	db	-1-	80		,	-1-	254
	db	-1-	80		,	-1-	254
	db	-1-	80		,	-1-	254
	db	-1-	80		,	-1-	254
	db	-1-	80		,	-1-	254
	db	-1-	80		,	-1-	254
	db	-1-	80		,	-1-	254
	db	-1-	80		,	-1-	254
	db	-1-	80		,	-1-	254
	db	-1-	80		,	-1-	254
	db	-1-	80		,	-1-	254
	db	-1-	80		,	-1-	254
	db	-1-	80		,	-1-	254
	db	-1-	80		,	-1-	254
	db	-1-	80		,	-1-	254
	db	-1-	80		,	-1-	254
	db	-1-	80		,	-1-	254
	db	-1-	80		,	-1-	254
	db	-1-	80		,	-1-	254
	db	-1-	80		,	-1-	254
	db	-1-	80		,	-1-	254
	db	-1-	80		,	-1-	254
	db	-1-	80		,	-1-	254
	db	-1-	80		,	-1-	254
	db	-1-	80		,	-1-	254
	db	-1-	80		,	-1-	254
	db	-1-	80		,	-1-	254
	db	-1-	80		,	-1-	254
	db	-1-	80		,	-1-	254
	db	-1-	80		,	-1-	254
	db	-1-	80		,	-1-	254
	db	-1-	80		,	-1-	254
	db	-1-	80		,	-1-	254
	db	-1-	80		,	-1-	254
	db	-1-	80		,	-1-	254
	db	-1-	80		,	-1-	254
	db	-1-	80		,	-1-	254
	db	-1-	80		,	-1-	254
	db	-1-	32		,	-1-	249
	db	-1-	36		,	-1-	244
	db	-1-	91		,	-1-	239
	db	-1-	192		,	-1-	234
	db	-1-	82		,	-1-	230
	db	-1-	14		,	-1-	226
	db	-1-	242		,	-1-	221
	db	-1-	252		,	-1-	217
	db	-1-	41		,	-1-	214
	db	-1-	119		,	-1-	210
	db	-1-	230		,	-1-	206
	db	-1-	115		,	-1-	203
	db	-1-	30		,	-1-	200
	db	-1-	227		,	-1-	196
	db	-1-	195		,	-1-	193
	db	-1-	188		,	-1-	190
	db	-1-	205		,	-1-	187
	db	-1-	244		,	-1-	184
	db	-1-	50		,	-1-	182
	db	-1-	132		,	-1-	179
	db	-1-	234		,	-1-	176
	db	-1-	99		,	-1-	174
	db	-1-	238		,	-1-	171
	db	-1-	139		,	-1-	169
	db	-1-	56		,	-1-	167
	db	-1-	246		,	-1-	164
	db	-1-	195		,	-1-	162
	db	-1-	158		,	-1-	160
	db	-1-	136		,	-1-	158
	db	-1-	128		,	-1-	156
	db	-1-	133		,	-1-	154
	db	-1-	151		,	-1-	152
	db	-1-	180		,	-1-	150
	db	-1-	222		,	-1-	148
	db	-1-	19		,	-1-	147
	db	-1-	82		,	-1-	145
	db	-1-	157		,	-1-	143
	db	-1-	241		,	-1-	141
	db	-1-	80		,	-1-	140
	db	-1-	183		,	-1-	138
	db	-1-	40		,	-1-	137
	db	-1-	162		,	-1-	135
	db	-1-	37		,	-1-	134
	db	-1-	175		,	-1-	132
	db	-1-	66		,	-1-	131
	db	-1-	221		,	-1-	129
	db	-1-	127		,	-1-	128
	db	-1-	40		,	-1-	127
	db	-1-	216		,	-1-	125
	db	-1-	144		,	-1-	124
	db	-1-	78		,	-1-	123
	db	-1-	18		,	-1-	122
	db	-1-	221		,	-1-	120
	db	-1-	173		,	-1-	119
	db	-1-	132		,	-1-	118
	db	-1-	96		,	-1-	117
	db	-1-	66		,	-1-	116
	db	-1-	41		,	-1-	115
	db	-1-	22		,	-1-	114
	db	-1-	7		,	-1-	113
	db	-1-	254		,	-1-	111
	db	-1-	249		,	-1-	110
	db	-1-	249		,	-1-	109
	db	-1-	254		,	-1-	108
	db	-1-	7		,	-1-	108
	db	-1-	20		,	-1-	107
	db	-1-	38		,	-1-	106
	db	-1-	60		,	-1-	105
	db	-1-	85		,	-1-	104
	db	-1-	115		,	-1-	103
	db	-1-	149		,	-1-	102
	db	-1-	186		,	-1-	101
	db	-1-	226		,	-1-	100
	db	-1-	15		,	-1-	100
	db	-1-	63		,	-1-	99
	db	-1-	114		,	-1-	98
	db	-1-	168		,	-1-	97
	db	-1-	226		,	-1-	96
	db	-1-	30		,	-1-	96

BPM_TABLE_B
	db	-1-	94		,	-1-	95
	db	-1-	161		,	-1-	94
	db	-1-	230		,	-1-	93
	db	-1-	47		,	-1-	93
	db	-1-	122		,	-1-	92
	db	-1-	200		,	-1-	91
	db	-1-	25		,	-1-	91
	db	-1-	108		,	-1-	90
	db	-1-	194		,	-1-	89
	db	-1-	26		,	-1-	89
	db	-1-	117		,	-1-	88
	db	-1-	210		,	-1-	87
	db	-1-	49		,	-1-	87
	db	-1-	147		,	-1-	86
	db	-1-	247		,	-1-	85
	db	-1-	93		,	-1-	85
	db	-1-	197		,	-1-	84
	db	-1-	48		,	-1-	84
	db	-1-	156		,	-1-	83
	db	-1-	11		,	-1-	83
	db	-1-	123		,	-1-	82
	db	-1-	237		,	-1-	81
	db	-1-	97		,	-1-	81
	db	-1-	215		,	-1-	80
	db	-1-	79		,	-1-	80
	db	-1-	201		,	-1-	79
	db	-1-	68		,	-1-	79
	db	-1-	193		,	-1-	78
	db	-1-	64		,	-1-	78
	db	-1-	192		,	-1-	77
	db	-1-	66		,	-1-	77
	db	-1-	198		,	-1-	76
	db	-1-	75		,	-1-	76
	db	-1-	210		,	-1-	75
	db	-1-	90		,	-1-	75
	db	-1-	228		,	-1-	74
	db	-1-	111		,	-1-	74
	db	-1-	251		,	-1-	73
	db	-1-	137		,	-1-	73
	db	-1-	25		,	-1-	73
	db	-1-	169		,	-1-	72
	db	-1-	59		,	-1-	72
	db	-1-	206		,	-1-	71
	db	-1-	99		,	-1-	71
	db	-1-	249		,	-1-	70
	db	-1-	144		,	-1-	70
	db	-1-	40		,	-1-	70
	db	-1-	193		,	-1-	69
	db	-1-	92		,	-1-	69
	db	-1-	247		,	-1-	68
	db	-1-	148		,	-1-	68
	db	-1-	50		,	-1-	68
	db	-1-	209		,	-1-	67
	db	-1-	113		,	-1-	67
	db	-1-	18		,	-1-	67
	db	-1-	181		,	-1-	66
	db	-1-	88		,	-1-	66
	db	-1-	252		,	-1-	65
	db	-1-	161		,	-1-	65
	db	-1-	71		,	-1-	65
	db	-1-	238		,	-1-	64
	db	-1-	150		,	-1-	64
	db	-1-	63		,	-1-	64
	db	-1-	233		,	-1-	63
	db	-1-	148		,	-1-	63
	db	-1-	64		,	-1-	63
	db	-1-	236		,	-1-	62
	db	-1-	154		,	-1-	62
	db	-1-	72		,	-1-	62
	db	-1-	247		,	-1-	61
	db	-1-	167		,	-1-	61
	db	-1-	88		,	-1-	61
	db	-1-	9		,	-1-	61
	db	-1-	187		,	-1-	60
	db	-1-	110		,	-1-	60
	db	-1-	34		,	-1-	60
	db	-1-	215		,	-1-	59
	db	-1-	140		,	-1-	59
	db	-1-	66		,	-1-	59
	db	-1-	249		,	-1-	58
	db	-1-	176		,	-1-	58
	db	-1-	104		,	-1-	58
	db	-1-	33		,	-1-	58
	db	-1-	218		,	-1-	57
	db	-1-	149		,	-1-	57
	db	-1-	79		,	-1-	57
	db	-1-	11		,	-1-	57
	db	-1-	199		,	-1-	56
	db	-1-	132		,	-1-	56
	db	-1-	65		,	-1-	56
	db	-1-	255		,	-1-	55
	db	-1-	189		,	-1-	55
	db	-1-	125		,	-1-	55
	db	-1-	60		,	-1-	55
	db	-1-	253		,	-1-	54
	db	-1-	189		,	-1-	54
	db	-1-	127		,	-1-	54
	db	-1-	65		,	-1-	54
	db	-1-	3		,	-1-	54
	db	-1-	199		,	-1-	53
	db	-1-	138		,	-1-	53
	db	-1-	78		,	-1-	53
	db	-1-	19		,	-1-	53
	db	-1-	216		,	-1-	52
	db	-1-	158		,	-1-	52
	db	-1-	100		,	-1-	52
	db	-1-	43		,	-1-	52
	db	-1-	242		,	-1-	51
	db	-1-	186		,	-1-	51
	db	-1-	130		,	-1-	51
	db	-1-	74		,	-1-	51
	db	-1-	19		,	-1-	51
	db	-1-	221		,	-1-	50
	db	-1-	167		,	-1-	50
	db	-1-	113		,	-1-	50
	db	-1-	60		,	-1-	50
	db	-1-	7		,	-1-	50
	db	-1-	211		,	-1-	49
	db	-1-	159		,	-1-	49
	db	-1-	108		,	-1-	49
	db	-1-	57		,	-1-	49
	db	-1-	6		,	-1-	49
	db	-1-	212		,	-1-	48
	db	-1-	162		,	-1-	48
	db	-1-	113		,	-1-	48
	db	-1-	64		,	-1-	48
	db	-1-	15		,	-1-	48
	db	-1-	223		,	-1-	47
