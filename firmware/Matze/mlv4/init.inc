init
	
	;----------------------------------------------------------------------------------
	; PortA and E: Digital Pins  
	;----------------------------------------------------------------------------------
	movlw	0x07
  	movwf	ADCON1

	;----------------------------------------------------------------------------------
  	;# DATABUS -> 8 Ausgänge
	;----------------------------------------------------------------------------------
  	clrf 	DATABUS_TRIS
  	clrf 	DATABUS

	;----------------------------------------------------------------------------------
  	;# DATABUS_STROBE -> 5 Ausgänge
	;----------------------------------------------------------------------------------
  	clrf	DATABUS_STROBE_TRIS
  	clrf 	DATABUS_STROBE
  
	;----------------------------------------------------------------------------------
  	;# Pullups deaktivieren
	;----------------------------------------------------------------------------------
	bsf		INTCON2, NOT_RBPU

	;----------------------------------------------------------------------------------
  	;# KEYBUS_STROBE -> Ausgänge
	;----------------------------------------------------------------------------------
  	clrf 	KEYBUS_STROBE_TRIS
  	clrf 	KEYBUS_STROBE
  
	;----------------------------------------------------------------------------------
  	;# KEYBUS -> 3 Eingänge
	;----------------------------------------------------------------------------------
  	bsf 	KEYBUS_TRIS, 0
  	bsf 	KEYBUS_TRIS, 1
  	bsf 	KEYBUS_TRIS, 2
  	bcf		KEYBUS_TRIS, 7

	;----------------------------------------------------------------------------------
  	;# GATEBUS -> 3 Ausgänge
	;----------------------------------------------------------------------------------
  	clrf 	GATEBUS_TRIS
  	clrf 	GATEBUS
  	clrf 	LATE

	;----------------------------------------------------------------------------------
	;# Alle LED-Register und VCO löschen
	;----------------------------------------------------------------------------------
	call	clr_leds   
	clrf 	VCO	
	clrf	VCO_OFF
	call	set_leds_timemode
	clrf	LAST_KEYPRESS
	clrf	KEYPRESS
	call	set_slide
	call	clr_slide
	call	clr_accent
	call	clr_gate
	
	;----------------------------------------------------------------------------------
	;# Pattern Bank 0
	;----------------------------------------------------------------------------------
	clrf	PAT_BANK

	;----------------------------------------------------------------------------------
	;# PatternBPM einstellen
	;----------------------------------------------------------------------------------
	; L und H
	clrf	TICK

	;----------------------------------------------------------------------------------
	;# Configuration
	;----------------------------------------------------------------------------------
	call	eereadcfg

	return

init2

	;----------------------------------------------------------------------------------
	; USART initalisieren
	;----------------------------------------------------------------------------------
  	;# set baudrate to 31250 baud
	movlw	(1 << TXEN)			
  	movwf	TXSTA
  	movlw	2*0x0a-1
  	movwf	SPBRG

  	;# Configure Receive Status and Control Register
  	movlw	(1 << SPEN) | (1 << CREN)
  	movwf	RCSTA
  	
	;----------------------------------------------------------------------------------
	; Timer initalisieren
	;----------------------------------------------------------------------------------
    ;movlw   (1 << TMR1ON)           ; switch on Timer1
    movlw	b'00110001'
    movwf   T1CON

	;----------------------------------------------------------------------------------
	; IRQ initalisieren
	;----------------------------------------------------------------------------------
	movlw   (1 << RCIE) | (1 << TMR1IE)
;	movlw   (1 << RCIE) | (1 << TMR2IE)
;	movlw   (1 << RCIE)
  	movwf   PIE1
  	clrf    PIE2                    ; clear all other IRQs

  	;# make sure that USART Receive Buffer is empty
  	bcf     RCSTA, CREN
  	movf    RCREG, W
  	bsf     RCSTA, CREN
	
  	;# enable maskable IRQs
  	movlw   (1 << GIE) | (1 << PEIE)
  	movwf   INTCON

	return	

